/*
 * oled.c - OLED Library Implementation for SSD1306 128x32
 */

#include "stm8.h"
#include "delay.h"
#include "i2c.h"
#include "oled.h"

/*=============================================
                Private Variables
===============================================*/
static unsigned char oled_buffer[OLED_WIDTH * OLED_PAGES];
static unsigned char oled_cursor_x = 0;
static unsigned char oled_cursor_y = 0;
static unsigned char oled_current_font = FONT_6X8;

// Font 6x8 (ASCII 32-127)
static const unsigned char font_6x8[96][6] = {
    {0x00,0x00,0x00,0x00,0x00,0x00}, // space
    {0x00,0x00,0x00,0x2f,0x00,0x00}, // !
    {0x00,0x00,0x07,0x00,0x07,0x00}, // "
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    {0x00,0x08,0x08,0x2a,0x1c,0x08}, // ~
};

/*=============================================
                Private Functions
===============================================*/
static void oled_write_cmd(unsigned char cmd)
{
    i2c_start();
    i2c_send_addr(OLED_ADDR);
    i2c_write(0x00);  // Command mode
    i2c_write(cmd);
    i2c_stop();
}

static void oled_write_cmd_multi(unsigned char* cmds, unsigned char len)
{
    unsigned char i;
    i2c_start();
    i2c_send_addr(OLED_ADDR);
    i2c_write(0x00);
    for(i = 0; i < len; i++) {
        i2c_write(cmds[i]);
    }
    i2c_stop();
}

static void oled_send_buffer(void)
{
    unsigned char page, col;
    
    for(page = 0; page < OLED_PAGES; page++) {
        // Set page address
        oled_write_cmd(0xB0 | page);
        oled_write_cmd(0x00);  // Low column
        oled_write_cmd(0x10);  // High column
        
        // Send page data
        i2c_start();
        i2c_send_addr(OLED_ADDR);
        i2c_write(0x40);  // Data mode
        
        for(col = 0; col < OLED_WIDTH; col++) {
            i2c_write(oled_buffer[page * OLED_WIDTH + col]);
        }
        i2c_stop();
    }
}

/*=============================================
                Public Functions
===============================================*/
void oled_init(void)
{
    delay_ms(100);
    
    unsigned char init_cmds[] = {
        0xAE,       // Display OFF
        0xD5, 0x80, // Set Display Clock
        0xA8, 0x1F, // Set Multiplex (32 lines)
        0xD3, 0x00, // Set Display Offset
        0x40,       // Set Start Line
        0x8D, 0x14, // Enable Charge Pump
        0x20, 0x00, // Memory Addressing Mode (Horizontal)
        0xA1,       // Segment Remap
        0xC8,       // COM Output Scan Direction
        0xDA, 0x02, // Set COM Pins (128x32)
        0x81, 0xCF, // Set Contrast
        0xD9, 0xF1, // Set Pre-charge
        0xDB, 0x40, // Set VCOMH
        0xA4,       // Display ON Resume
        0xA6,       // Normal Display
        0xAF        // Display ON
    };
    
    oled_write_cmd_multi(init_cmds, sizeof(init_cmds));
    
    // Clear buffer
    oled_clear();
}

void oled_deinit(void)
{
    oled_write_cmd(0xAE);  // Display OFF
}

void oled_clear(void)
{
    unsigned short i;
    for(i = 0; i < sizeof(oled_buffer); i++) {
        oled_buffer[i] = 0x00;
    }
    oled_send_buffer();
}

void oled_clear_page(unsigned char page)
{
    unsigned char col;
    if(page >= OLED_PAGES) return;
    
    for(col = 0; col < OLED_WIDTH; col++) {
        oled_buffer[page * OLED_WIDTH + col] = 0x00;
    }
    
    // Update only this page
    oled_write_cmd(0xB0 | page);
    oled_write_cmd(0x00);
    oled_write_cmd(0x10);
    
    i2c_start();
    i2c_send_addr(OLED_ADDR);
    i2c_write(0x40);
    for(col = 0; col < OLED_WIDTH; col++) {
        i2c_write(0x00);
    }
    i2c_stop();
}

void oled_update(void)
{
    oled_send_buffer();
}

void oled_set_pixel(unsigned char x, unsigned char y, unsigned char color)
{
    unsigned char page, bit;
    
    if(x >= OLED_WIDTH || y >= OLED_HEIGHT) return;
    
    page = y / 8;
    bit = y % 8;
    
    if(color) {
        oled_buffer[page * OLED_WIDTH + x] |= (1 << bit);
    } else {
        oled_buffer[page * OLED_WIDTH + x] &= ~(1 << bit);
    }
}

void oled_draw_line(unsigned char x1, unsigned char y1, unsigned char x2, unsigned char y2, unsigned char color)
{
    int dx, dy, sx, sy, err, e2;
    
    dx = (x2 > x1) ? (x2 - x1) : (x1 - x2);
    dy = (y2 > y1) ? (y2 - y1) : (y1 - y2);
    sx = (x1 < x2) ? 1 : -1;
    sy = (y1 < y2) ? 1 : -1;
    err = dx - dy;
    
    while(1) {
        oled_set_pixel(x1, y1, color);
        if(x1 == x2 && y1 == y2) break;
        e2 = 2 * err;
        if(e2 > -dy) { err -= dy; x1 += sx; }
        if(e2 < dx) { err += dx; y1 += sy; }
    }
}

void oled_draw_rect(unsigned char x, unsigned char y, unsigned char w, unsigned char h, unsigned char color)
{
    oled_draw_line(x, y, x + w - 1, y, color);
    oled_draw_line(x, y, x, y + h - 1, color);
    oled_draw_line(x + w - 1, y, x + w - 1, y + h - 1, color);
    oled_draw_line(x, y + h - 1, x + w - 1, y + h - 1, color);
}

void oled_fill_rect(unsigned char x, unsigned char y, unsigned char w, unsigned char h, unsigned char color)
{
    unsigned char i, j;
    for(i = x; i < x + w; i++) {
        for(j = y; j < y + h; j++) {
            oled_set_pixel(i, j, color);
        }
    }
}

void oled_gotoxy(unsigned char x, unsigned char y)
{
    if(x < OLED_WIDTH && y < OLED_HEIGHT) {
        oled_cursor_x = x;
        oled_cursor_y = y;
    }
}

void oled_putc(char c)
{
    if(c == '\n') {
        oled_cursor_x = 0;
        oled_cursor_y += 8;
        return;
    }
    
    if(c >= 32 && c <= 127) {
        unsigned char i;
        unsigned char idx = c - 32;
        
        for(i = 0; i < 6; i++) {
            unsigned char data = font_6x8[idx][i];
            unsigned char j;
            for(j = 0; j < 8; j++) {
                if(data & (1 << j)) {
                    oled_set_pixel(oled_cursor_x + i, oled_cursor_y + j, 1);
                }
            }
        }
        oled_cursor_x += 6;
        
        if(oled_cursor_x > OLED_WIDTH - 6) {
            oled_cursor_x = 0;
            oled_cursor_y += 8;
        }
    }
}

void oled_puts(const char* str)
{
    while(*str) {
        oled_putc(*str++);
    }
    oled_update();
}

void oled_puts_at(unsigned char x, unsigned char y, const char* str)
{
    oled_gotoxy(x, y);
    oled_puts(str);
}

void oled_set_font(unsigned char font_size)
{
    oled_current_font = font_size;
}

void oled_set_contrast(unsigned char contrast)
{
    oled_write_cmd(0x81);
    oled_write_cmd(contrast);
}

void oled_invert(void)
{
    oled_write_cmd(0xA7);  // Invert display
}

void oled_normal(void)
{
    oled_write_cmd(0xA6);  // Normal display
}

void oled_scroll_left(unsigned char pages, unsigned char speed)
{
    if(pages > 7) pages = 7;
    if(speed > 7) speed = 7;
    
    unsigned char cmd[] = {
        0x26,               // Continuous horizontal scroll left
        0x00,               // Dummy byte
        0x00,               // Start page
        speed,              // Speed
        pages - 1,          // End page
        0x00,               // Dummy
        0xFF                // Dummy
    };
    oled_write_cmd_multi(cmd, 7);
    oled_write_cmd(0x2F);   // Activate scroll
}

void oled_scroll_right(unsigned char pages, unsigned char speed)
{
    if(pages > 7) pages = 7;
    if(speed > 7) speed = 7;
    
    unsigned char cmd[] = {
        0x27,               // Continuous horizontal scroll right
        0x00,               // Dummy byte
        0x00,               // Start page
        speed,              // Speed
        pages - 1,          // End page
        0x00,               // Dummy
        0xFF                // Dummy
    };
    oled_write_cmd_multi(cmd, 7);
    oled_write_cmd(0x2F);   // Activate scroll
}

void oled_scroll_stop(void)
{
    oled_write_cmd(0x2E);   // Deactivate scroll
}

void oled_print_number(unsigned int num)
{
    char buffer[6];
    unsigned char i = 0;
    
    if(num == 0) {
        oled_putc('0');
        return;
    }
    
    while(num > 0) {
        buffer[i++] = (num % 10) + '0';
        num /= 10;
    }
    
    while(i > 0) {
        oled_putc(buffer[--i]);
    }
}

void oled_print_hex(unsigned char num)
{
    unsigned char high = (num >> 4) & 0x0F;
    unsigned char low = num & 0x0F;
    
    oled_putc(high < 10 ? high + '0' : high - 10 + 'A');
    oled_putc(low < 10 ? low + '0' : low - 10 + 'A');
}